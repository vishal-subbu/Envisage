//
// Copyright (c) 2018, Vishal_S
// All rights reserved. Please read the "license.txt" for license terms.
//
// Project Title: Waterfall Graphic Print
//
// Developer: Vishal S
//
// Contact Info: vishalsubbu97@gmail.com
//
//*************************************************************
//   CODE TO WRITE INFORMATION INTO TWO SHIFT REGISTERS
//                   USING COMMON PINS
//*************************************************************

//Pin connected to ST_CP(12) of 74HC595
int latchPin = 12;
//Pin connected to SH_CP(11) of 74HC595,CLK od SD
int clockPin = 11;
////Pin connected to DS(14) of 74HC595,MOSI
int dataPin = 8;


//*********************************************
//                  HEADER FILES
//*********************************************
#include <SPI.h>
#include <EEPROM.h>


// Variables for holding values 
byte shift[8];

byte values[]={129,252,3,255,240,31,223,128,193,254,3,249,240,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192,127};
int length=800;
int d=10;
int index=0;

void setup()
{
  pinMode(latchPin,OUTPUT);
  pinMode(clockPin, OUTPUT );
  pinMode(dataPin, OUTPUT );
  Serial.begin(57600);
}//  END OF SETUP 


void loop()
{
  digitalWrite(latchPin,0);
  for(int i=0;i<8;i++)
  {
    shift[i]=values[index];
    index++;
  }
  for(int j=0;j<8;j++)
  {
    shiftOut(shift[j]);
  }
  digitalWrite(latchPin,1);
  Serial.println();
  if(index>=length)
    index=0;
  delay(d); 


}//    END OF LOOP


void shiftOut(byte value)
{
  int i=0;
  int pinstate;
  digitalWrite(dataPin,0);
  digitalWrite(clockPin,0);
  for(i=7;i>=0;i--)
    {
      digitalWrite(clockPin,0);
      if ( value & (1<<i) ) 
        {
          pinstate= 1;
        }
      else 
        {	
          pinstate= 0;
        }
      digitalWrite(dataPin,pinstate);
      Serial.print(pinstate);
      digitalWrite(clockPin,1);
      digitalWrite(dataPin,0);
    }
    digitalWrite(clockPin,0) ;
    
}//   END OF SHIFT OUT
